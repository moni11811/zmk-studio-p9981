## firmware/source/app/boards/arm/bbp9981/bbp9981_nrf52840_zmk_defconfig
```kconfig
# Copyright (c) 2025 ZitaoTech
# SPDX-License-Identifier: MIT

# Use pinctrl
CONFIG_PINCTRL=y

# Enable GPIO
CONFIG_GPIO=y

# Flash & UF2 output
CONFIG_BUILD_OUTPUT_UF2=y
CONFIG_MPU_ALLOW_FLASH_WRITE=y
CONFIG_FLASH=y

# Enable both USB and BLE
CONFIG_ZMK_USB=y
CONFIG_ZMK_BLE=y

# Keyboard backlight (PWM)
CONFIG_ZMK_BACKLIGHT=y
CONFIG_ZMK_BACKLIGHT_BRT_START=40
CONFIG_ZMK_BACKLIGHT_BRT_STEP=10
CONFIG_ZMK_BACKLIGHT_ON_START=y
CONFIG_ZMK_BACKLIGHT_AUTO_OFF_IDLE=y

# RGB underglow (WS2812 single LED)
CONFIG_ZMK_RGB_UNDERGLOW=y
CONFIG_ZMK_RGB_UNDERGLOW_EXT_POWER=n

# I2C for trackpad (Avago A320)
CONFIG_I2C=y

# Trackpad / pointing device
CONFIG_ZMK_POINTING=y

# ZMK Studio RPC support
CONFIG_ZMK_STUDIO=y
CONFIG_ZMK_STUDIO_LOCKING=n
CONFIG_ZMK_STUDIO_LOCK_ON_DISCONNECT=n

# HID indicators
CONFIG_ZMK_HID_INDICATORS=y

# Idle timeout (30s)
CONFIG_ZMK_IDLE_TIMEOUT=30000
CONFIG_ZMK_SLEEP=n
CONFIG_ZMK_PM_SOFT_OFF=n
CONFIG_ZMK_EXT_POWER=y
```

## firmware/source/app/boards/arm/bbp9981/board.yml
```yaml
board:
  name: bbp9981
  vendor: zitaotech
  socs:
    - name: nrf52840
      variants:
        - name: zmk
```
